// SPDX-License-Identifier: GPL-2.0-or-later OR MIT

/dts-v1/;
#include "../dts/mt7981b-mediatek-7981r128.dts"

/ {
	model = "MediaTek 7981R128 (MTK U-Boot layout)";
	compatible = "mediatek,7981r128-mtkuboot", "mediatek,mt7981";
};

&spi_nand {
	mediatek,nmbm;
	mediatek,bmt-max-ratio = <1>;
	mediatek,bmt-max-reserved-blocks = <64>;

	spi-cal-enable;
	spi-cal-mode = "read-data";
	spi-cal-datalen = <7>;
	spi-cal-data = /bits/ 8 <0x53 0x50 0x49 0x4e 0x41 0x4e 0x44>;
	spi-cal-addrlen = <5>;
	spi-cal-addr = /bits/ 32 <0x0 0x0 0x0 0x0 0x0>;
};
